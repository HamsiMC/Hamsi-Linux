## meta-hamsi/conf/distro/hamsi.conf
```bitbake
# SPDX-License-Identifier: MIT

require conf/distro/include/default-distrovars.inc
require conf/distro/include/default-providers.inc
require conf/distro/include/security_flags.inc
require conf/distro/include/init-manager-systemd.inc

DISTRO = "hamsi"
DISTRO_NAME = "Hamsi Linux"
DISTRO_VERSION = "0.1.0"
DISTRO_CODENAME = "Karadeniz"
DISTRO_VERSION_CODENAME = "karadeniz"
DISTRO_MAINTAINER = "Hamsi Linux contributors"
HOME_URL = "https://github.com/HamsiMC/Hamsi-Linux"
SUPPORT_URL = "https://github.com/HamsiMC/Hamsi-Linux/issues"
BUG_REPORT_URL = "https://github.com/HamsiMC/Hamsi-Linux/issues"

TCLIBC = "glibc"
PACKAGE_CLASSES = "package_rpm"
SDKMACHINE = "x86_64"

DISTRO_FEATURES:append = " acl alsa bluetooth desktop-portal ipv6 opengl pam polkit pulseaudio seccomp systemd usrmerge vulkan wayland wifi x11 xattr zeroconf"
DISTRO_FEATURES_BACKFILL_CONSIDERED += "sysvinit"
VIRTUAL-RUNTIME_init_manager = "systemd"
VIRTUAL-RUNTIME_initscripts = ""
VIRTUAL-RUNTIME_dev_manager = "udev"

PREFERRED_PROVIDER_virtual/kernel = "linux-yocto"
PREFERRED_PROVIDER_virtual/mesa = "mesa"
PREFERRED_PROVIDER_virtual/libgl = "mesa"
PREFERRED_PROVIDER_virtual/libgles2 = "mesa"

GLIBC_GENERATE_LOCALES = "en_US.UTF-8 tr_TR.UTF-8"
IMAGE_LINGUAS = "en-us tr-tr"
ENABLE_BINARY_LOCALE_GENERATION = "1"

LICENSE_FLAGS_ACCEPTED += "commercial_yandex"

INHERIT += "buildhistory create-spdx-3.0"
BUILDHISTORY_COMMIT = "0"
SPDX_INCLUDE_SOURCES = "0"
SPDX_ARCHIVE_PACKAGED = "0"

PACKAGECONFIG:append:pn-pipewire = " pipewire-alsa"
PACKAGECONFIG:append:pn-networkmanager = " wifi bluetooth"
PACKAGECONFIG:append:pn-sddm = " systemd"

WARN_QA:append = " patch-fuzz"
ERROR_QA:append = " license-checksum"
```

## meta-hamsi/conf/layer.conf
```bitbake
# SPDX-License-Identifier: MIT

BBPATH .= ":${LAYERDIR}"

BBFILES += "${LAYERDIR}/recipes-*/*/*.bb \
            ${LAYERDIR}/recipes-*/*/*.bbappend"

BBFILE_COLLECTIONS += "hamsi"
BBFILE_PATTERN_hamsi = "^${LAYERDIR}/"
BBFILE_PRIORITY_hamsi = "20"

LAYERDEPENDS_hamsi = "core openembedded-layer filesystems-layer networking-layer multimedia-layer gnome-layer meta-python qt6-layer kf6 kde"
LAYERSERIES_COMPAT_hamsi = "wrynose"
```
